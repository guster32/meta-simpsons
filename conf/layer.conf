## conf/layer.conf
```bitbake
# We have a conf and classes directory, add to BBPATH
BBPATH .= ":${LAYERDIR}"

BBPATH .= ":${LAYERDIR}/../meta-arcadia"

# We have recipes-* directories, add to BBFILES
BBFILES += "${LAYERDIR}/recipes-*/*/*.bb \
            ${LAYERDIR}/recipes-*/*/*.bbappend"
BBFILE_COLLECTIONS += "simpsons"
BBFILE_PATTERN_simpsons = "^${LAYERDIR}/"
BBFILE_PRIORITY_simpsons = "7"

LAYERDEPENDS_simpsons = "arcadia"
LAYERSERIES_COMPAT_simpsons = "nanbield scarthgap"
```
